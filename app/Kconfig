## app/Kconfig
```kconfig
config APP_HEARTBEAT_PERIOD_MS
    int "Heartbeat period (ms)"
    default 500
    range 100 2000
    help
    Blink period for the heartbeat LED in milliseconds. This value determines how often the heartbeat LED will toggle its state.

source "Kconfig.zephyr"
```
